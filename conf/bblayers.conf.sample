## conf/bblayers.conf.sample
```bitbake
# LAYER_CONF_VERSION is increased each time build/conf/bblayers.conf
# changes incompatibly
LCONF_VERSION = "5"

BBPATH = "${TOPDIR}"
BBFILES ?= ""
OEROOT := "${@os.path.abspath(os.path.dirname(d.getVar('FILE', True)) + '/../..')}"

BBLAYERS ?= " \
  ${OEROOT}/openembedded-core/meta \
  ${OEROOT}/meta-openembedded/toolchain-layer \
  ${OEROOT}/meta-openembedded/meta-multimedia \
  ${OEROOT}/meta-openembedded/meta-oe \
  ${OEROOT}/meta-openembedded/meta-ruby \
  ${OEROOT}/meta-openembedded/meta-networking \
  ${OEROOT}/meta-linaro/meta-linaro \
  ${OEROOT}/meta-linaro/meta-linaro-toolchain \
  ${OEROOT}/meta-qt5 \
  "

BBLAYERS_NON_REMOVABLE ?= " \
  ${RDKROOT}/openembedded-core/meta \
  "
```

## conf/distro/hisdk.conf
```bitbake
# Distribution definition for: hisdk


# from dev manual:
# Your configuration file needs to set the following variables:
#
#      DISTRO_NAME [required]
#      DISTRO_VERSION [required]
#      DISTRO_FEATURES [required if creating from scratch]
#      DISTRO_EXTRA_RDEPENDS [optional]
#      DISTRO_EXTRA_RRECOMMENDS [optional]
#      TCLIBC [required if creating from scratch]


DISTRO = "hisdk"
DISTRO_NAME = "HiSDK"
DISTRO_VERSION = "0.1+snapshot-${DATE}"

MAINTAINER = "Yan Haifeng <haifeng.yan@linaro.org>"

TARGET_VENDOR = "-hisdk"

LOCALCONF_VERSION = "1"
LAYER_CONF_VERSION ?= "5"

DISTRO_FEATURES_append = " largefile opengles multiarch"

PREFERRED_VERSION_linux-yocto ?= "3.4%"
PREFERRED_VERSION_linux-yocto_qemux86 ?= "3.8%"
PREFERRED_VERSION_linux-yocto_qemux86-64 ?= "3.8%"
PREFERRED_VERSION_linux-yocto_qemuarm ?= "3.8%"
PREFERRED_VERSION_linux-yocto_qemumips ?= "3.8%"
PREFERRED_VERSION_linux-yocto_qemuppc ?= "3.8%"

DISTRO_FEATURES_BACKFILL_CONSIDERED = "pulseaudio"

# TODO: is that really want we want?
IMAGE_LINGUAS = ""

# Pick linaro-gcc
GCCVERSION = "linaro-4.8"
SDKGCCVERSION = "linaro-4.8"

#SDK_NAME = "${DISTRO}-${TCLIBC}-${SDK_ARCH}-${TARGET_ARCH}"
#SDKPATH = "/opt/${DISTRO}/${SDK_VERSION}"

#EXTRAOPKGCONFIG = "poky-feed-config-opkg"

# Override these in poky based distros to modify DISTRO_EXTRA_R*
#POKY_DEFAULT_EXTRA_RDEPENDS = "packagegroup-core-boot"
#POKY_DEFAULT_EXTRA_RRECOMMENDS = "kernel-module-af-packet"

#DISTRO_EXTRA_RDEPENDS += " ${POKY_DEFAULT_EXTRA_RDEPENDS}"
#DISTRO_EXTRA_RRECOMMENDS += " ${POKY_DEFAULT_EXTRA_RRECOMMENDS}"

POKYQEMUDEPS = "${@base_contains("INCOMPATIBLE_LICENSE", "GPLv3", "", "qemu-config",d)}"
DISTRO_EXTRA_RDEPENDS_append_qemuarm = " ${POKYQEMUDEPS}"
DISTRO_EXTRA_RDEPENDS_append_qemumips = " ${POKYQEMUDEPS}"
DISTRO_EXTRA_RDEPENDS_append_qemuppc = " ${POKYQEMUDEPS}"
DISTRO_EXTRA_RDEPENDS_append_qemux86 = " ${POKYQEMUDEPS}"
DISTRO_EXTRA_RDEPENDS_append_qemux86-64 = " ${POKYQEMUDEPS}"

TCLIBCAPPEND = ""

QEMU_TARGETS ?= "arm i386 mips mipsel ppc x86_64"
# Other QEMU_TARGETS "mips64 mips64el sh4"

PREMIRRORS ??= "\
bzr://.*/.*   http://downloads.yoctoproject.org/mirror/sources/ \n \
cvs://.*/.*   http://downloads.yoctoproject.org/mirror/sources/ \n \
git://.*/.*   http://downloads.yoctoproject.org/mirror/sources/ \n \
hg://.*/.*    http://downloads.yoctoproject.org/mirror/sources/ \n \
osc://.*/.*   http://downloads.yoctoproject.org/mirror/sources/ \n \
p4://.*/.*    http://downloads.yoctoproject.org/mirror/sources/ \n \
svk://.*/.*   http://downloads.yoctoproject.org/mirror/sources/ \n \
svn://.*/.*   http://downloads.yoctoproject.org/mirror/sources/ \n"

MIRRORS =+ "\
ftp://.*/.*      http://downloads.yoctoproject.org/mirror/sources/ \n \
http://.*/.*     http://downloads.yoctoproject.org/mirror/sources/ \n \
https://.*/.*    http://downloads.yoctoproject.org/mirror/sources/ \n"

# append Linaro mirrors as our last chance to find what we are looking for
MIRRORS =+ "\
git://.*/.*      http://snapshots.linaro.org/openembedded/sources/ \n \
svn://.*/.*      http://snapshots.linaro.org/openembedded/sources/ \n \
bzr://.*/.*      http://snapshots.linaro.org/openembedded/sources/ \n \
ftp://.*/.*      http://snapshots.linaro.org/openembedded/sources/ \n \
http://.*/.*     http://snapshots.linaro.org/openembedded/sources/ \n \
https://.*/.*    http://snapshots.linaro.org/openembedded/sources/ \n"

# The CONNECTIVITY_CHECK_URI's are used to test whether we can succesfully
# fetch from the network (and warn you if not). To disable the test set
# the variable to be empty.
# Git example url: git://git.yoctoproject.org/yocto-firewall-test;protocol=git;rev=HEAD

CONNECTIVITY_CHECK_URIS ?= " \
             https://eula-downloads.yoctoproject.org/index.php \
             http://bugzilla.yoctoproject.org/report.cgi"

# SANITY_TESTED_DISTROS ?= " \
#             Yocto-1.2 \n \
#             Poky-1.2 \n \
#             Poky-1.3 \n \
#             Ubuntu-10.04 \n \
#             Ubuntu-11.10 \n \
#             Ubuntu-12.04 \n \
#             Ubuntu-12.10 \n \
#             Fedora-16 \n \
#             Fedora-17 \n \
#             Fedora-18 \n \
#             CentOS-5.6 \n \
#             CentOS-5.7 \n \
#             CentOS-5.8 \n \
#             CentOS-6.3 \n \
#             Debian-6.0 \n \
#             Debian-7.0 \n \
#             SUSE-LINUX-11.4 \n \
#             SUSE-LINUX-12.1 \n \
#             SUSE-LINUX-12.2 \n \
#       "

# Default hash policy for distro
BB_SIGNATURE_HANDLER ?= 'OEBasicHash'
#
# OELAYOUT_ABI allows us to notify users when the format of TMPDIR changes in
# an incompatible way. Such changes should usually be detailed in the commit
# that breaks the format and have been previously discussed on the mailing list
# with general agreement from the core team.
#
OELAYOUT_ABI = "8"

# add poky sanity bbclass
# INHERIT += "poky-sanity"

#WARN_QA = "unsafe-references-in-binaries unsafe-references-in-scripts"
WARN_QA = "textrel pkgvarcheck"
ERROR_QA = "dev-so debug-deps dev-deps debug-files arch la2 pkgconfig la perms useless-rpaths rpaths staticdev ldflags"

include conf/distro/include/seperatebuilddir.inc

### end of poky.conf

## # FIXME: consider adding a new "tiny" feature
## #DISTRO_FEATURES_append = " tiny"
##
## # Distro config is evaluated after the machine config, so we have to explicitly
## # set the kernel provider to override a machine config.
## PREFERRED_PROVIDER_virtual/kernel = "linux-yocto-tiny"
## PREFERRED_VERSION_linux-yocto-tiny = "3.4%"
##
## # We can use packagegroup-core-boot, but in the future we may need a new packagegroup-core-tiny
## #POKY_DEFAULT_EXTRA_RDEPENDS += "packagegroup-core-boot"
## # Drop kernel-module-af-packet from RRECOMMENDS
## POKY_DEFAULT_EXTRA_RRECOMMENDS = ""
##
## # FIXME: what should we do with this?
## TCLIBCAPPEND = ""
##
## # Disable wide char support for ncurses as we don't include it in
## # in the LIBC features below.
## ENABLE_WIDEC="false"
##
## # Drop native language support. This removes the
## # eglibc->bash->gettext->libc-posix-clang-wchar dependency.
## USE_NLS="no"
##
## # -dev packages require pkgconfig, but it pulls in glib->dbus->shadow
## # which breaks with tiny's minimal libc.
## # -dev packages are not currently supported on poky-tiny.
## ASSUME_PROVIDED += "pkgconfig$"
##
## # Reconfigure eglibc for a smaller installation
## # Comment out any of the lines below to disable them in the build
## DISTRO_FEATURES_LIBC_TINY = "libc-libm libc-crypt"
## DISTRO_FEATURES_LIBC_TINY_append_x86-64 = " libc-libm-big"
##
## # Required for "who"
## DISTRO_FEATURES_LIBC_MINIMAL = "libc-utmp libc-getlogin"
## DISTRO_FEATURES_LIBC_REGEX = "libc-posix-regexp"
## DISTRO_FEATURES_LIBC_NET = "libc-inet libc-nis"
##
## DISTRO_FEATURES_LIBC = "${DISTRO_FEATURES_LIBC_TINY} \
##                         ${DISTRO_FEATURES_LIBC_MINIMAL} \
##                         ${DISTRO_FEATURES_LIBC_REGEX} \
##                         ${DISTRO_FEATURES_LIBC_NET} \
##                        "
##
## # Comment out any of the lines below to disable them in the build
## # DISTRO_FEATURES options:
## # alsa bluetooth ext2 irda pcmcia usbgadget usbhost wifi nfs zeroconf pci
## # DISTRO_FEATURES_TINY = "pci"
## # DISTRO_FEATURES_NET = "ipv4"
## # DISTRO_FEATURES_USB = "usbhost"
## # DISTRO_FEATURES_USBGADGET = "usbgadget"
## # DISTRO_FEATURES_WIFI = "wifi"
## #
## # DISTRO_FEATURES = "${DISTRO_FEATURES_TINY} \
## #                    ${DISTRO_FEATURES_NET} \
## #                    ${DISTRO_FEATURES_USB} \
## #                    ${DISTRO_FEATURES_USBGADGET} \
## #                    ${DISTRO_FEATURES_WIFI} \
## #                    ${DISTRO_FEATURES_LIBC} \
## #                   "

DISTRO_FEATURES = "alsa argp ext2 largefile usbgadget usbhost ipv4 xattr nfs zeroconf directfb ${DISTRO_FEATURES_LIBC} ${DISTRO_FEATURES_INITMAN}"


# Use tmpdevfs and the busybox runtime services
VIRTUAL-RUNTIME_dev_manager = ""
VIRTUAL-RUNTIME_login_manager = ""
VIRTUAL-RUNTIME_init_manager = "sysvinit"
VIRTUAL-RUNTIME_keymaps = ""

# FIXME: Consider adding "modules" to MACHINE_FEATURES and using that in
# packagegroup-core-base to select modutils-initscripts or not.  Similar with "net" and
# netbase.

# We want tar.gz for our CI loop
IMAGE_FSTYPES += "tar.gz"

# The mtrace script included by eglibc is a perl script. This means the system
# will build perl in case this package is installed. Since we don't care about
# this script for the purposes of tiny, remove the dependency from here.
RDEPENDS_${PN}-mtrace_pn-eglibc = ""

LICENSE_FLAGS_WHITELIST += "commercial_gst-fluendo-mpegdemux"
```

## conf/machine/hi3716cv200-linaro.conf
```bitbake
#@TYPE: Machine
#@NAME: hi3716cv200 machine
#@DESCRIPTION: hi3716v200  machine

DEFAULTTUNE ?= "armv7athf-neon"

require conf/machine/include/arm/arch-armv7a.inc


MACHINE_FEATURES = "usbhost screen"

#MACHINE_ESSENTIAL_EXTRA_RDEPENDS += "drivers-hi3716cv200 driverlibs-hi3716cv200"

# Use a hi3716cv200es kernel and driverlibs recipe
PREFERRED_PROVIDER_virtual/kernel ?= "linux-linaro-dkb"
#PREFERRED_PROVIDER_virtual/driverlibs-hisilicon ?= "driverlibs-hi3716cv200"

# Use hi3716cv200es GLES h/w libs 
#PREFERRED_PROVIDER_virtual/egl ?= "gpulib-hi3716cv200"
#PREFERRED_PROVIDER_virtual/libgles1 ?= "gpulib-hi3716cv200"
#PREFERRED_PROVIDER_virtual/libgles2 ?= "gpulib-hi3716cv200"

# Add hi3716cv200 dependency for gstreamer
#RRECOMMENDS_gstreamer_append = " gst-openmax gst-hivosink gst-ffmpeg"

KERNEL_IMAGETYPE = "zImage"

#MKUBIFS_ARGS = "-F -m 4096 -e 1040384 -c 256"
#UBINIZE_ARGS = "-m 4096 -p 1048576"

IMAGE_FSTYPES = "ext4"

# Force auto-serial-console to be used by all image types
# Ideally this would be part of core oe or as a bbclassappend,
# but as we don't have an easy way to append a class, defining
# it here
#EXTRA_IMAGE_FEATURES += "autoserial"
#PACKAGE_GROUP_autoserial = "auto-serial-console"

LICENSE_FLAGS_WHITELIST += "commercial_gst-openmax"
LICENSE_FLAGS_WHITELIST += "commercial_libomxil"
LICENSE_FLAGS_WHITELIST += "commercial_libmad"
LICENSE_FLAGS_WHITELIST += "commercial_gst-ffmpeg"
```

## conf/machine/hi3716cv200.conf
```bitbake
#@TYPE: Machine
#@NAME: hi3716cv200 machine
#@DESCRIPTION: hi3716v200  machine

DEFAULTTUNE ?= "cortexa9thf-neon"

require conf/machine/include/tune-cortexa9.inc


MACHINE_FEATURES = "usbhost screen"

MACHINE_ESSENTIAL_EXTRA_RDEPENDS += "drivers-hi3716cv200 driverlibs-hi3716cv200"

# Use a hi3716cv200es kernel and driverlibs recipe
PREFERRED_PROVIDER_virtual/kernel ?= "linux-hi3716cv200"
PREFERRED_PROVIDER_virtual/driverlibs-hisilicon ?= "driverlibs-hi3716cv200"

# Use hi3716cv200es GLES h/w libs 
PREFERRED_PROVIDER_virtual/egl ?= "gpulib-hi3716cv200"
PREFERRED_PROVIDER_virtual/libgles1 ?= "gpulib-hi3716cv200"
PREFERRED_PROVIDER_virtual/libgles2 ?= "gpulib-hi3716cv200"

# Add hi3716cv200 dependency for gstreamer
RRECOMMENDS_gstreamer_append = " gst-openmax gst-hivosink gst-ffmpeg"
RRECOMMENDS_gstreamer1.0_append = " gst-hisiomx gstreamer1.0-hivosink gstreamer1.0-libav"

KERNEL_IMAGETYPE = "uImage"

MKUBIFS_ARGS = "-F -m 4096 -e 1040384 -c 256"
UBINIZE_ARGS = "-m 4096 -p 1048576"

IMAGE_FSTYPES = "ext3 ubi squashfs"

# Force auto-serial-console to be used by all image types
# Ideally this would be part of core oe or as a bbclassappend,
# but as we don't have an easy way to append a class, defining
# it here
EXTRA_IMAGE_FEATURES += "autoserial"
PACKAGE_GROUP_autoserial = "auto-serial-console"

LICENSE_FLAGS_WHITELIST += "commercial_gst-openmax"
LICENSE_FLAGS_WHITELIST += "commercial_libomxil"
LICENSE_FLAGS_WHITELIST += "commercial_libmad"
LICENSE_FLAGS_WHITELIST += "commercial_gst-ffmpeg"
LICENSE_FLAGS_WHITELIST += "commercial_libav"
LICENSE_FLAGS_WHITELIST += "commercial_x264"
LICENSE_FLAGS_WHITELIST += "commercial_gstreamer1.0-omx"
LICENSE_FLAGS_WHITELIST += "commercial_gstreamer1.0-libav"
LICENSE_FLAGS_WHITELIST += "commercial_gst-hisiomx"
```
